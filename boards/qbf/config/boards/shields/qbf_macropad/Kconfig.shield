## ergogen-kikad/config/boards/shields/qbf_macropad/Kconfig.defconfig
```kconfig
if SHIELD_QBF_MACROPAD

config ZMK_KEYBOARD_NAME
    default "QBF Macro Pad"

endif
```

## ergogen-kikad/config/module/Kconfig
```kconfig
config QBF_JDI_DISPLAY
    bool "QBF LPM009M360A memory LCD"
    depends on DISPLAY
    select SPI
    select GPIO
```

## ergogen-kikad/config/module/dts/bindings/display/qbf,lpm009m360a.yaml
```yaml
description: QBF landscape LPM009M360A memory LCD
compatible: "qbf,lpm009m360a"
include: [spi-device.yaml, display-controller.yaml]
properties:
  disp-gpios:
    type: phandle-array
    required: true
  extcomin-gpios:
    type: phandle-array
    required: true
```
